## main/Kconfig.projbuild
```kconfig
menu "CSI Capture Configuration"

    config CSI_WIFI_SSID
        string "WiFi SSID of the dedicated router"
        default "YOUR_SSID"
        help
            SSID of the dedicated router for CSI capture.
            The router should be configured for 2.4GHz only, 802.11n, 40MHz, fixed channel.

    config CSI_WIFI_PASSWORD
        string "WiFi Password"
        default "YOUR_PASSWORD"
        help
            Password for the dedicated router's WiFi network.
            Change this to your actual router password via menuconfig.

    config CSI_WIFI_CHANNEL
        int "WiFi Channel (fixed)"
        default 6
        range 1 13
        help
            Fixed channel number matching the router configuration.
            Must match the router's channel setting exactly.

    config CSI_UART_BAUD
        int "Serial baud rate for CSI output"
        default 921600
        range 115200 921600
        help
            Baud rate for UART console output. 921600 is required for
            high-throughput CSI streaming. Must match the baud rate used
            by the PC capture/visualize scripts.

    config CSI_FILTER_TARGET_MAC
        bool "Filter CSI by target source MAC"
        default n
        help
            If enabled, the firmware will only enqueue CSI frames whose
            source MAC matches CSI_TARGET_MAC. This avoids mixed-emitter
            captures that can contaminate the training dataset.

    config CSI_TARGET_MAC
        string "Target source MAC address (aa:bb:cc:dd:ee:ff)"
        default ""
        depends on CSI_FILTER_TARGET_MAC
        help
            Source MAC to accept in CSI callback. Use the router/BSSID MAC.
            Example: d8:47:32:2e:4c:f9

endmenu
```

## sdkconfig.defaults
```kconfig
# Wi-Fi Vision 3D - ESP32-S3 CSI Capture defaults

# Wi-Fi
CONFIG_ESP_WIFI_STATIC_RX_BUFFER_NUM=10
CONFIG_ESP_WIFI_DYNAMIC_RX_BUFFER_NUM=32
CONFIG_ESP_WIFI_RX_BA_WIN=16
CONFIG_ESP_WIFI_CSI_ENABLED=y

# Console output at maximum baud for CSI data throughput
CONFIG_ESP_CONSOLE_UART_BAUDRATE=921600

# Increase main task stack for initialization
CONFIG_ESP_MAIN_TASK_STACK_SIZE=4096

# Logging: INFO level for status reports during CSI streaming
CONFIG_LOG_DEFAULT_LEVEL_INFO=y
CONFIG_LOG_DEFAULT_LEVEL=3

# Disable WiFi power save for maximum CSI throughput
CONFIG_ESP_WIFI_STA_DISCONNECTED_PM_ENABLE=n

# FreeRTOS tick rate for finer timing resolution
CONFIG_FREERTOS_HZ=1000
```
